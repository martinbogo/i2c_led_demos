/* 
 * Author  : Martin Bogomolni
 * Date    : 2026-04-06
 * License : CC BY-NC 4.0 (https://creativecommons.org/licenses/by-nc/4.0/)
 * 
 * badapple.c - Split-screen 128x48 1-bit Raw Video Player for SSD1306
 *
 * Attribution & Thanks:
 * - Music Rights: ZUN (Japan) holds the original song rights.
 * - Shadow Video: The iconic 2009 black-and-white shadow-art video was created by Anira.
 *
 * Reserves exactly the top 16 physical Yellow pixels on the OLED for a static 
 * 2x-scaled "BAD APPLE" title track. Constrains the entire streaming I2C logic
 * explicitly to bounding the bottom 48 Blue pixels at 30 FPS.
 */

#include <fcntl.h>
#include <linux/i2c-dev.h>
#include <stdint.h>
#include <stdio.h>
#include <sys/ioctl.h>
#include <unistd.h>
#include <string.h>
#include <math.h>
#include <time.h>
#include <zlib.h>

#define ADDR 0x3C
#define WIDTH 128
#define HEIGHT 64
#define PAGES (HEIGHT / 8)

static int i2c_fd;
static uint8_t fb[1024];

static void usage(const char *argv0) {
    fprintf(stderr,
            "usage: %s [-d] [-h|-?]\n"
            "  -d      run as a daemon\n"
            "  -h, -?  show this help message\n"
            "\n"
            "Requires bad_apple.bin.gz in the current working directory.\n",
            argv0);
}

static void init_display(void) {
    uint8_t cmds[] = {
        0x00, 0xAE, 0xD5, 0x80, 0xA8, 0x3F, 0xD3, 0x00, 0x40,
        0x8D, 0x14, 0x20, 0x00, 0xA1, 0xC8, 0xDA, 0x12,
        0x81, 0xCF, 0xD9, 0xF1, 0xDB, 0x40, 0xA4, 0xA6, 0xAF
    };
    write(i2c_fd, cmds, sizeof(cmds));
}

static void flush(void) {
    uint8_t ac[] = {0x00, 0x21, 0, 127, 0x22, 0, 7};
    if (write(i2c_fd, ac, sizeof(ac)) < 0) return;
    
    for (int i = 0; i < 1024; i += 32) {
        uint8_t buf[33]; 
        buf[0] = 0x40;
        memcpy(buf + 1, fb + i, 32);
        if (write(i2c_fd, buf, 33) < 0) return;
    }
}

static void px(int x, int y) {
    if (x >= 0 && x < WIDTH && y >= 0 && y < HEIGHT)
        fb[x + (y / 8) * WIDTH] |= 1 << (y & 7);
}

static void fill_rect(int x0, int y0, int x1, int y1) {
    if (x0 > x1) { int t = x0; x0 = x1; x1 = t; }
    if (y0 > y1) { int t = y0; y0 = y1; y1 = t; }
    for (int y = y0; y <= y1; y++)
        for (int x = x0; x <= x1; x++)
            px(x, y);
}

static const uint8_t font5x7[][5] = {
    {0x00,0x00,0x00,0x00,0x00},{0x00,0x00,0x5F,0x00,0x00},
    {0x00,0x07,0x00,0x07,0x00},{0x14,0x7F,0x14,0x7F,0x14},
    {0x24,0x2A,0x7F,0x2A,0x12},{0x23,0x13,0x08,0x64,0x62},
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    {0x08,0x08,0x2A,0x1C,0x08},
};

static void draw_large_char(int x, int y, char c, int scale) {
    if (c < 32 || c > 126) c = '?';
    const uint8_t *g = font5x7[c - 32];
    for (int col = 0; col < 5; col++) {
        uint8_t bits = g[col];
        for (int row = 0; row < 7; row++) {
            if (bits & (1 << row)) {
                fill_rect(x + col * scale, y + row * scale, 
                          x + col * scale + scale - 1, y + row * scale + scale - 1);
            }
        }
    }
}

static void draw_large_str(int x, int y, const char *s, int scale) {
    while (*s) { draw_large_char(x, y, *s++, scale); x += (5 + 1) * scale; }
}

int main(int argc, char *argv[]) {
    int daemonize = 0;
    for (int i = 1; i < argc; i++) {
        if (strcmp(argv[i], "-d") == 0) {
            daemonize = 1;
        } else if (strcmp(argv[i], "-h") == 0 || strcmp(argv[i], "-?") == 0) {
            usage(argv[0]);
            return 0;
        } else {
            usage(argv[0]);
            return 1;
        }
    }
    if (daemonize) { if (daemon(0, 0) == -1) return 1; }

    i2c_fd = open("/dev/i2c-1", O_RDWR);
    if (i2c_fd < 0) { perror("i2c-1"); return 1; }
    if (ioctl(i2c_fd, I2C_SLAVE, ADDR) < 0) { perror("ioctl"); return 1; }
    init_display();

    /* Clear and prepare background headers */
    memset(fb, 0, 1024);
    draw_large_str(10, 1, "BAD APPLE!", 2);

    gzFile f = gzopen("bad_apple.bin.gz", "rb");
    if (!f) {
        printf("Error: Could not locate bad_apple.bin.gz payload chunk!\n");
        return 1;
    }
    
    long frame_ns = 1000000000L / 30; // 30 FPS target
    struct timespec next;
    clock_gettime(CLOCK_MONOTONIC, &next);
    
    /* Dedicated A/V Sync Engine bounding to true hardware time */
    while(gzread(f, fb + 256, 768) == 768) {
        struct timespec curr;
        clock_gettime(CLOCK_MONOTONIC, &curr);
        
        long lag_ns = (curr.tv_sec - next.tv_sec) * 1000000000L + (curr.tv_nsec - next.tv_nsec);
        
        /* Frame-skip logic: If the I2C bus pipeline is drastically lagging behind Real-Time (>1 frame), 
           we skip emitting this frame to the hardware entirely to catch up geometrically with the audio */
        if (lag_ns < frame_ns) {
            flush();
        }

        /* Calculate absolute bounds for the forthcoming frame execution target */
        next.tv_nsec += frame_ns;
        while (next.tv_nsec >= 1000000000L) {
            next.tv_nsec -= 1000000000L;
            next.tv_sec += 1;
        }
        
        /* If we are ahead of schedule, sleep precisely until the atomic deadline triggers */
        clock_gettime(CLOCK_MONOTONIC, &curr);
        long wait_ns = (next.tv_sec - curr.tv_sec) * 1000000000L + (next.tv_nsec - curr.tv_nsec);
        if (wait_ns > 0 && wait_ns < 1000000000L) {
            clock_nanosleep(CLOCK_MONOTONIC, TIMER_ABSTIME, &next, NULL);
        }
    }
    gzclose(f);
    
    memset(fb, 0, 1024); flush();
    uint8_t off[2] = {0x00, 0xAE};
    if (write(i2c_fd, off, 2) < 0) return 1;
    close(i2c_fd);
    
    return 0;
}
