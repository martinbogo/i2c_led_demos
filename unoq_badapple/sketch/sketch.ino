#include <Arduino.h>
#include <Wire.h>
#include <stdint.h>
#include <stdio.h>
#include <string.h>

namespace {
constexpr uint8_t OLED_ADDR = 0x3C;
constexpr uint8_t WIDTH = 128;
constexpr uint8_t HEIGHT = 64;
constexpr uint8_t HEADER_PAGES = 2;
constexpr uint8_t VIDEO_PAGES = 6;
constexpr size_t HEADER_BYTES = WIDTH * HEADER_PAGES;
constexpr size_t VIDEO_BYTES = WIDTH * VIDEO_PAGES;
constexpr size_t I2C_CHUNK = 31;
constexpr unsigned long SERIAL_BAUD = 460800;
constexpr unsigned long FRAME_READ_GAP_TIMEOUT_MS = 120;
constexpr char PROTOCOL_MAGIC[] = {'B', 'A', 'P', 'P'};

uint8_t headerBuffer[HEADER_BYTES] = {0};
uint8_t videoBuffer[VIDEO_BYTES] = {0};
uint32_t displayedFrames = 0;

void sendSerialLine(const char *message) {
  Serial1.println(message);
}

void sendSerialValue(const char *prefix, uint32_t value) {
  Serial1.print(prefix);
  Serial1.println(value);
}

bool sendCommandBytes(const uint8_t *bytes, size_t count) {
  Wire.beginTransmission(OLED_ADDR);
  Wire.write(0x00);
  for (size_t i = 0; i < count; ++i) {
    Wire.write(bytes[i]);
  }
  return Wire.endTransmission() == 0;
}

bool sendDataBytes(const uint8_t *bytes, size_t count) {
  while (count > 0) {
    const size_t chunk = count > I2C_CHUNK ? I2C_CHUNK : count;
    Wire.beginTransmission(OLED_ADDR);
    Wire.write(0x40);
    for (size_t i = 0; i < chunk; ++i) {
      Wire.write(bytes[i]);
    }
    if (Wire.endTransmission() != 0) {
      return false;
    }
    bytes += chunk;
    count -= chunk;
  }
  return true;
}

bool setWindow(uint8_t colStart, uint8_t colEnd, uint8_t pageStart, uint8_t pageEnd) {
  const uint8_t cmds[] = {0x21, colStart, colEnd, 0x22, pageStart, pageEnd};
  return sendCommandBytes(cmds, sizeof(cmds));
}

bool clearDisplay() {
  static uint8_t zeroPage[WIDTH] = {0};
  for (uint8_t page = 0; page < HEIGHT / 8; ++page) {
    if (!setWindow(0, WIDTH - 1, page, page)) {
      return false;
    }
    if (!sendDataBytes(zeroPage, sizeof(zeroPage))) {
      return false;
    }
  }
  return true;
}

bool initDisplay() {
  const uint8_t init[] = {
      0xAE, 0xD5, 0x80, 0xA8, 0x3F, 0xD3, 0x00, 0x40,
      0x8D, 0x14, 0x20, 0x00, 0xA1, 0xC8, 0xDA, 0x12,
      0x81, 0xCF, 0xD9, 0xF1, 0xDB, 0x40, 0xA4, 0xA6,
      0xAF,
  };
  return sendCommandBytes(init, sizeof(init));
}

bool flushHeader() {
  return setWindow(0, WIDTH - 1, 0, HEADER_PAGES - 1) && sendDataBytes(headerBuffer, sizeof(headerBuffer));
}

bool flushVideo() {
  return setWindow(0, WIDTH - 1, HEADER_PAGES, HEADER_PAGES + VIDEO_PAGES - 1) && sendDataBytes(videoBuffer, sizeof(videoBuffer));
}

void setHeaderPixel(int x, int y) {
  if (x < 0 || x >= WIDTH || y < 0 || y >= 16) {
    return;
  }
  headerBuffer[x + (y / 8) * WIDTH] |= static_cast<uint8_t>(1U << (y & 7));
}

void fillHeaderRect(int x0, int y0, int x1, int y1) {
  if (x0 > x1) {
    const int t = x0;
    x0 = x1;
    x1 = t;
  }
  if (y0 > y1) {
    const int t = y0;
    y0 = y1;
    y1 = t;
  }
  for (int y = y0; y <= y1; ++y) {
    for (int x = x0; x <= x1; ++x) {
      setHeaderPixel(x, y);
    }
  }
}

const uint8_t font5x7[][5] = {
    {0x00,0x00,0x00,0x00,0x00},{0x00,0x00,0x5F,0x00,0x00},
    {0x00,0x07,0x00,0x07,0x00},{0x14,0x7F,0x14,0x7F,0x14},
    {0x24,0x2A,0x7F,0x2A,0x12},{0x23,0x13,0x08,0x64,0x62},
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    {0x08,0x08,0x2A,0x1C,0x08},
};

void drawLargeChar(int x, int y, char c, int scale) {
  if (c < 32 || c > 126) {
    c = '?';
  }
  const uint8_t *glyph = font5x7[c - 32];
  for (int col = 0; col < 5; ++col) {
    const uint8_t bits = glyph[col];
    for (int row = 0; row < 7; ++row) {
      if (bits & (1 << row)) {
        fillHeaderRect(x + col * scale, y + row * scale,
                       x + col * scale + scale - 1,
                       y + row * scale + scale - 1);
      }
    }
  }
}

void drawLargeString(int x, int y, const char *text, int scale) {
  while (*text) {
    drawLargeChar(x, y, *text++, scale);
    x += (5 + 1) * scale;
  }
}

void prepareHeader() {
  memset(headerBuffer, 0, sizeof(headerBuffer));
  drawLargeString(10, 1, "BAD APPLE!", 2);
}

size_t readExact(uint8_t *buffer, size_t count) {
  size_t total = 0;
  unsigned long deadline = millis() + FRAME_READ_GAP_TIMEOUT_MS;

  while (total < count) {
    const int available = Serial1.available();
    if (available > 0) {
      int remaining = available;
      while (remaining-- > 0 && total < count) {
        const int incoming = Serial1.read();
        if (incoming < 0) {
          break;
        }
        buffer[total++] = static_cast<uint8_t>(incoming);
      }
      deadline = millis() + FRAME_READ_GAP_TIMEOUT_MS;
      continue;
    }

    if (static_cast<long>(millis() - deadline) >= 0) {
      break;
    }
    delay(1);
  }

  return total;
}

bool waitForMagicAndCommand(char &commandOut) {
  static size_t matched = 0;
  static bool waitingForCommand = false;

  if (waitingForCommand) {
    if (Serial1.available() == 0) {
      return false;
    }
    commandOut = static_cast<char>(Serial1.read());
    waitingForCommand = false;
    return true;
  }

  while (Serial1.available() > 0) {
    const int incoming = Serial1.read();
    if (incoming < 0) {
      break;
    }
    if (incoming == PROTOCOL_MAGIC[matched]) {
      ++matched;
      if (matched == sizeof(PROTOCOL_MAGIC)) {
        matched = 0;
        if (Serial1.available() == 0) {
          waitingForCommand = true;
          return false;
        }
        commandOut = static_cast<char>(Serial1.read());
        return true;
      }
    } else {
      matched = (incoming == PROTOCOL_MAGIC[0]) ? 1 : 0;
    }
  }
  return false;
}

void handleFrame() {
  const size_t got = readExact(videoBuffer, sizeof(videoBuffer));
  if (got != sizeof(videoBuffer)) {
    Serial1.print("ERR SHORT ");
    Serial1.println(static_cast<unsigned long>(got));
    return;
  }
  if (!flushVideo()) {
    sendSerialLine("ERR DISPLAY");
    return;
  }
  ++displayedFrames;
  sendSerialValue("ACK ", displayedFrames);
}

void handleCommand(char command) {
  switch (command) {
    case 'Q':
      sendSerialLine("READY BADAPPLE_UNOQ");
      break;
    case 'F':
      handleFrame();
      break;
    case 'E':
      sendSerialValue("DONE ", displayedFrames);
      break;
    default:
      sendSerialLine("ERR CMD");
      break;
  }
}
}  // namespace

void setup() {
  Serial1.begin(SERIAL_BAUD);
  Serial1.setTimeout(1500);

  Wire.begin();
  Wire.setClock(400000);

  delay(50);
  if (!initDisplay()) {
    sendSerialLine("ERR INIT");
    return;
  }
  clearDisplay();
  prepareHeader();
  if (!flushHeader()) {
    sendSerialLine("ERR HEADER");
    return;
  }
  sendSerialLine("BOOT BADAPPLE_UNOQ");
}

void loop() {
  char command = 0;
  if (!waitForMagicAndCommand(command)) {
    delay(1);
    return;
  }
  handleCommand(command);
}
